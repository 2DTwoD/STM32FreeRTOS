#include "init.h"

void rccInit(){
	RCC->CR |= RCC_CR_HSEON;
	while(!(RCC->CR & RCC_CR_HSERDY));

	setRegister32(&RCC->CFGR,
				RCC_CFGR_PLLMULL | RCC_CFGR_PLLSRC,
				RCC_CFGR_PLLMULL9 | RCC_CFGR_PLLSRC_HSE);

	RCC->CR |= RCC_CR_PLLON;
	while(!(RCC->CR & RCC_CR_PLLRDY));

	FLASH->ACR |= FLASH_ACR_LATENCY_2;

	setRegister32(&RCC->CFGR,
				RCC_CFGR_HPRE | RCC_CFGR_PPRE1 | RCC_CFGR_PPRE2,
				RCC_CFGR_PPRE1_2);
	RCC->CFGR |= RCC_CFGR_SW_1;
	while(!(RCC->CFGR & RCC_CFGR_SWS_1));

	RCC->CFGR &= ~RCC_CR_HSION;
}

void portInit(){
	RCC->APB2ENR |= RCC_APB2ENR_IOPCEN;
	setRegister32(&GPIOC->CRH,
			GPIO_CRH_MODE13 | GPIO_CRH_CNF13,
			GPIO_CRH_MODE13_1 | GPIO_CRH_CNF15_1);
	GPIOC->ODR &= ~GPIO_ODR_ODR15;
}

void uartInit(){
	RCC->APB2ENR |= RCC_APB2ENR_USART1EN;
	RCC->APB2ENR |= RCC_APB2ENR_IOPAEN;
	setRegister32(&GPIOA->CRH,
			GPIO_CRH_MODE9 | GPIO_CRH_CNF9 | GPIO_CRH_MODE10 | GPIO_CRH_CNF10,
			GPIO_CRH_MODE9_0 | GPIO_CRH_CNF9_1 | GPIO_CRH_CNF10_1);
	GPIOA->ODR |= GPIO_ODR_ODR10;
	
	NVIC_EnableIRQ(USART1_IRQn);
	setRegister16(&USART1->CR1,
			ALL_16_BITS,
			USART_CR1_UE | USART_CR1_TE | USART_CR1_RE | USART_CR1_RXNEIE);// | USART_CR1_TXEIE
	
	USART1->CR2 = 0;
	USART1->CR3 = 0;
	USART1->BRR = 0x1D4C;
}

void extiInit(){
	RCC->APB2ENR |= RCC_APB2ENR_IOPAEN;
	RCC->APB2ENR |= RCC_APB2ENR_AFIOEN; 
	
	setRegister32(&GPIOA->CRL,
		GPIO_CRL_MODE0 | GPIO_CRL_CNF0,
		GPIO_CRL_CNF0_1);
	
	NVIC_EnableIRQ(EXTI0_IRQn);
	
	EXTI->FTSR |= EXTI_FTSR_TR0;
	EXTI->RTSR |= EXTI_RTSR_TR0;
	setRegister32(&AFIO->EXTICR[0], AFIO_EXTICR1_EXTI0, AFIO_EXTICR1_EXTI0_PA);
	GPIOA->ODR |= GPIO_ODR_ODR0;
	EXTI->PR |= EXTI_PR_PR0;
	EXTI->IMR |= EXTI_IMR_MR0;
}
